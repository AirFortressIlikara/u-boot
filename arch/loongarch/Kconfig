## arch/loongarch/Kconfig
```kconfig
menu "LOONGARCH architecture"
	depends on LOONGARCH

config SYS_ARCH
	default "loongarch"

choice
	prompt "Target select"
	optional

config TARGET_LOONGSON_2K
	bool "Support Loongson LA platform"
	select OF_CONTROL
	select OF_LIBFDT
	select DM
	select DM_SERIAL
	imply DISPLAY_CPUINFO
	imply CMD_DM
	select SUPPORT_SPL
	select SPL_OF_CONTROL if SPL_DM
	select SPL_DM_SERIAL if SPL_DM
	select LAST_STAGE_INIT
	select SPL_BOARD_INIT if SPL
	help
	  This supports loongson platform

endchoice

# board-specific options below
source "board/loongson/ls2k300/Kconfig"

# platform-specific options below
source "arch/loongarch/mach-loongson/Kconfig"

# architecture-specific options below
choice
	prompt "Base ISA"

config ARCH_LA64
	bool "LoongArch64"
	select 64BIT
	select PHYS_64BIT
	help
	  Choose this option to target the LoongArch64 base ISA.

endchoice

config DMA_ADDR_T_64BIT
	bool
	default y if 64BIT
	help
	 Select this to enable 64-bit DMA addressing

endmenu
```

## board/loongson/common/Kconfig
```kconfig
menu "Loongson common options"

config LOONGSON_MMC_HIGH_PERFORMANCE
    bool "Change MMC-PAD to 0x7, will support HS200 mode"
    default n

config LOONGSON_USB_LOW_PAD
    bool "Change USB-PAD to 0x1, Some Board USB is better"
    default n

endmenu
```

## board/loongson/ls2k300/Kconfig
```kconfig
if SOC_LS2K300

config SYS_CPU
	default "LA264"

config SYS_SOC
	default "ls2k300"

config SYS_BOARD
	default "ls2k300"

config SYS_VENDOR
	default "loongson"

config SYS_CONFIG_NAME
	default "loongson_2k300"

source "board/loongson/common/Kconfig"

endif
```
