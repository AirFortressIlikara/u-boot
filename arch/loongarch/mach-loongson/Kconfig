## arch/loongarch/mach-loongson/Kconfig
```kconfig
menu "Loongson setup"
choice
	prompt "Loongson soc family select"
	depends on ARCH_LA_LOONGSON

config SOC_LS2K300
	bool "Support for LS2K300 family SoCs"
	depends on SUPPORTS_CPU_LOONGARCH64
	select SYS_CACHE_SHIFT_6

endchoice

choice
	prompt "CPU freq select"
	depends on ARCH_LA_LOONGSON

config CPU_500MHZ
	bool "500MHz"

config CPU_600MHZ
	bool "600MHz"

config CPU_700MHZ
	bool "700MHz"

config CPU_800MHZ
	bool "800MHz"
	depends on SOC_LS2K300

config CPU_900MHZ
	bool "900MHz"
	depends on SOC_LS2K300

config CPU_1000MHZ
	bool "1000MHz"
	depends on SOC_LS2K300

config CPU_1100MHZ
	bool "1100MHz"
	depends on SOC_LS2K300
endchoice

config SYS_CPU
	default "LA264" if SOC_LS2K300

config SYS_SOC
	default "ls2k300" if SOC_LS2K300

config CPU_FREQ
	int
	default 500 if CPU_500MHZ
	default 600 if CPU_600MHZ
	default 700 if CPU_700MHZ
	default 800 if CPU_800MHZ
	default 900 if CPU_900MHZ
	default 1000 if CPU_1000MHZ
	default 1100 if CPU_1100MHZ

source "board/loongson/Kconfig"

endmenu
```

## board/loongson/Kconfig
```kconfig
config MACH_LOONGSON
	bool
	default y if ARCH_LA_LOONGSON || ARCH_MIPS_LOONGSON
	select LAST_STAGE_INIT
	select SPL_BOARD_INIT if SPL

config SYS_VENDOR
	default "loongson"

if SOC_LS2K500
config SYS_BOARD
	default "ls2k500"

config SYS_CONFIG_NAME
	default "loongson_2k500"

endif

if SOC_LS2K300
config SYS_BOARD
	default "ls2k300"

config SYS_CONFIG_NAME
	default "loongson_2k300"

endif

source "board/loongson/common/Kconfig"
```
